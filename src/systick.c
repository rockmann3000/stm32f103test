#include "systick.h"
#include "globaldefinitions.h"

// Инициализация таймера SysTick

void SysTick_Init(void)
{

    // Значения для загрузки в SysTick (1 миллисекунда)
    // Справедливы, если таймер работает на частоте ядра от HSI 8МГц (LS) или от PLL (72МГц)
    //   Для частоты 8 МГц (8000000 / 1000 - 1)
    //   Для частоты 72 МГц (72000000 / 1000 - 1)
    static const uint32_t SYSTICK_1MS_LS = 7999U;  // Значение для HSI (8 МГц)
    static const uint32_t SYSTICK_1MS_HS = 71999U; // Значение для PLL (72 МГц)

    // 1. Проверяем, от чего сейчас работает ядро (опрос регистра RCC->CFGR)
    // Маска RCC_CFGR_SWS выделяет биты [3:2] статуса источника

    // 2. Выбираем правильное значение для 1 миллисекунды на основе источника
    if ((RCC->CFGR & RCC_CFGR_SWS) == RCC_CFGR_SWS_PLL)
    {
        // Если работает PLL (в вашей будущей конфигурации это будет 72 МГц или 64 МГц)
        // Внимание: если вы планируете разную частоту PLL (64 и 72), здесь можно будет
        // сделать дополнительную проверку множителя. Для текущей задумки на будущее:
        SysTick_Config(SYSTICK_1MS_HS); // Константа для высокой частоты (71999U)
    }
    else
    {
        // Если работает чистый HSI (8 МГц) или чистый HSE (8 МГц)
        SysTick_Config(SYSTICK_1MS_LS); // Константа для базовой частоты (7999U)
    }
    NVIC_SetPriority(SysTick_IRQn,0); // Поднимаем SysTick на высший уровень

}

// Классическая функция задержки: хранится в одном экземпляре, принимает аргумент.

void delay_ms(uint32_t ms)
{
    if (ms == 0)
        return;

    FLG_SYSTICK_INT = 0; // Чистим флаг на случай, если он остался от прошлых действий
    SysTick_Reset();     // Сбрасываем счетчик перед началом отсчета
    SysTick_Start();     // Запускаем счет таймера

    while (ms > 0)
    {
        // Опрос атомарного флага
        while (FLG_SYSTICK_INT == 0)
        {
            // Процессор ждет установки флага FLG_SYSTICK_INT
        }

        FLG_SYSTICK_INT = 0; // Сбрасываем флаг для следующей миллисекунды
        ms--;
    }

    SysTick_Stop(); // Останавливаем таймер после завершения задержки
}

// Обработчик прерывания SysTick

void SysTick_Handler(void)
{
    FLG_SYSTICK_INT = 1; // Атомарно устанавливаем флаг сработки таймера
}